#include "corne_cirque_left_shared.dtsi"

&glidepoint_listener {
    status = "okay";
    device = <&glidepoint_split>;
};

/ {
    split_inputs {
        #address-cells = <1>;
        #size-cells = <0>;

        glidepoint_split: glidepoint_split@0 {
            compatible = "zmk,input-split";
            reg = <0>;
        };
    };
};
