&pro_micro_spi {
    status = "okay";
    cs-gpios = <&pro_micro 5 GPIO_ACTIVE_LOW>;

    glidepoint: glidepoint@0 {
        compatible = "cirque,pinnacle";
        reg = <0>;
        spi-max-frequency = <1000000>;
        status = "okay";
        dr-gpios = <&pro_micro 8 (GPIO_ACTIVE_HIGH)>;

        sensitivity = "1x";
        //invert-x;
        sleep;
        // no-taps;
    };
};
