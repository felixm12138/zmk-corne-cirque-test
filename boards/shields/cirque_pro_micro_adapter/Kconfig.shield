## boards/shields/cirque_pro_micro_adapter/Kconfig.shield
```kconfig
config SHIELD_CIRQUE_PRO_MICRO_ADAPTER_I2C
    def_bool $(shields_list_contains,cirque_pro_micro_adapter_i2c)

config SHIELD_CIRQUE_PRO_MICRO_ADAPTER_SPI
    def_bool $(shields_list_contains,cirque_pro_micro_adapter_spi)
```

## boards/shields/corne_cirque/Kconfig.defconfig
```kconfig
if SHIELD_CORNE_CIRQUE_LEFT || SHIELD_CORNE_CIRQUE_LEFT_WITH_DEVICE

config ZMK_KEYBOARD_NAME
    default "Corne Cirque-us"

config ZMK_SPLIT_ROLE_CENTRAL
    default y

endif # SHIELD_CORNE_CIRQUE_LEFT || SHIELD_CORNE_CIRQUE_LEFT_WITH_DEVICE

if SHIELD_CORNE_CIRQUE_LEFT || SHIELD_CORNE_CIRQUE_RIGHT || SHIELD_CORNE_CIRQUE_LEFT_WITH_DEVICE || SHIELD_CORNE_CIRQUE_RIGHT_WITH_DEVICE

config ZMK_SPLIT
    default y

config ZMK_POINTING
    default y

endif # SHIELD_CORNE_CIRQUE_LEFT || SHIELD_CORNE_CIRQUE_RIGHT || SHIELD_CORNE_CIRQUE_LEFT_WITH_DEVICE || SHIELD_CORNE_CIRQUE_RIGHT_WITH_DEVICE

if SHIELD_CORNE_CIRQUE_LEFT_WITH_DEVICE || SHIELD_CORNE_CIRQUE_RIGHT_WITH_DEVICE

config I2C
    default y

endif # SHIELD_CORNE_CIRQUE_LEFT_WITH_DEVICE || SHIELD_CORNE_CIRQUE_RIGHT_WITH_DEVICE
```

## boards/shields/corne_cirque/Kconfig.shield
```kconfig
config SHIELD_CORNE_CIRQUE_LEFT
    def_bool $(shields_list_contains,corne_cirque_left)

config SHIELD_CORNE_CIRQUE_RIGHT
    def_bool $(shields_list_contains,corne_cirque_right)

config SHIELD_CORNE_CIRQUE_LEFT_WITH_DEVICE
    def_bool $(shields_list_contains,corne_cirque_left_with_device)

config SHIELD_CORNE_CIRQUE_RIGHT_WITH_DEVICE
    def_bool $(shields_list_contains,corne_cirque_right_with_device)
```
